## config/west.yml
```yaml
manifest:
  remotes:
    - name: zmkfirmware
      url-base: https://github.com/zmkfirmware
    - name: urob
      url-base: https://github.com/urob
    - name: urie
      url-base: https://github.com/Urie96
  projects:
    - name: zmk
      remote: urie
      revision: main
      import: app/west.yml
  self:
    path: config
```
